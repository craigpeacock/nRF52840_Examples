## CMakeLists.txt
```
# SPDX-License-Identifier: Apache-2.0

cmake_minimum_required(VERSION 3.20.0)

find_package(Zephyr REQUIRED HINTS $ENV{ZEPHYR_BASE})
project(I2C_Sensor)

FILE(GLOB app_sources src/*.c)
target_sources(app PRIVATE ${app_sources})
```

## prj.conf
```kconfig
CONFIG_I2C=y
CONFIG_NEWLIB_LIBC_FLOAT_PRINTF=y
CONFIG_CBPRINTF_FP_SUPPORT=y

CONFIG_CONSOLE=y

# Use Segger RTT Console
CONFIG_RTT_CONSOLE=y
CONFIG_USE_SEGGER_RTT=y

# If target is nRF52840-Dongle, don't link for use with nRF5 Bootloader
CONFIG_BOARD_HAS_NRF5_BOOTLOADER=n
```

## src/main.c
```c
#include <stdio.h>
#include <string.h>
#include <stdint.h>
#include <device.h>
#include <zephyr.h>
#include <drivers/i2c.h>

#include "ina226.h"
#include "shtc3.h"

void main(void)
{
	printk("I2C INA226 Current and Power Monitor\n");

	const struct device *dev;

  	printk("Opening I2C\n");
  	dev = device_get_binding("I2C_0");
  	if (!dev) {
		printk("I2C: Device driver not found.\n");
		return;
  	} else {
        i2c_configure(dev, I2C_SPEED_SET(I2C_SPEED_STANDARD));
  	}

	uint16_t temperature;
	uint16_t humidity;

	shtc3_readid(dev);

	while (1) {
		shtc3_wakeup(dev);
		k_msleep(1);
		shtc3_GetTempAndHumidity(dev, &temperature, &humidity);
		shtc3_sleep(dev);
		printk("Temp %.02f RH %.01f\r\n", shtc3_convert_temp(temperature), shtc3_convert_humd(humidity)); 
		k_msleep(1000);
	}

	ina226_init(dev);

	while (1) {

		printf("Voltage = %.03f V, ", ina226_voltage(dev));
		printf("Current = %.03f A, ", ina226_current(dev));
		printf("Power = %.02f W\r\n", ina226_power(dev));

		k_msleep(1000);
	}
}
```

## src/i2c.c
```c
#include <zephyr.h>
#include <device.h>
#include <stdint.h>
#include <device.h>
#include <sys/printk.h>
#include <device.h>
#include <drivers/i2c.h>
#include <sys/byteorder.h>

int8_t i2c_write_short(const struct device *i2c_dev, uint8_t address, uint8_t command, uint16_t byte)
{
    int ret;
    uint8_t data[3];

    data[0] = command;
    data[1] = (byte & 0xFF00) >> 8;
    data[2] = byte & 0xFF;

    ret = i2c_write(i2c_dev, (uint8_t *)&data, 3, address);
    if (ret) {
        printk("Error writing to I2C error code (%d)\n", ret);
        return (-1);
    }
    return(0);
}

int16_t i2c_read_short(const struct device *i2c_dev, uint8_t address, uint8_t command)
{
    int ret;
    uint16_t data;
   
    ret = i2c_write_read(i2c_dev, address, &command, 1, &data, 2);
    if (ret) {
        printk("Error reading from I2C error code (%d)\n", ret);
        return (-1);
    }

    return(__bswap_16(data));
}
```

## src/i2c.h
```c
int8_t i2c_write_short(const struct device *i2c_dev, uint8_t address, uint8_t command, uint16_t data);
int16_t i2c_read_short(const struct device *i2c_dev, uint8_t address, uint8_t command);
```

## src/ina226.c
```c
/*
 * INA226 - TI Current/Voltage/Power Monitor Code
 * Copyright (C) 2021 Craig Peacock
 *
 * This program is free software; you can redistribute it and/or
 * modify it under the terms of the GNU General Public License
 * as published by the Free Software Foundation; either version 3
 * of the License, or (at your option) any later version.
 *
 * This program is distributed in the hope that it will be useful,
 * but WITHOUT ANY WARRANTY; without even the implied warranty of
 * MERCHANTABILITY or FITNESS FOR A PARTICULAR PURPOSE.  See the
 * GNU General Public License for more details.
 *
 * You should have received a copy of the GNU General Public License
 * along with this program; if not, write to the Free Software
 * Foundation, Inc., 51 Franklin Street, Fifth Floor, Boston, MA
 * 02110-1301, USA.
 */

#include <stdio.h>
#include <string.h>
#include <stdint.h>
#include <device.h>
#include "i2c.h"
#include "ina226.h"

void ina226_init(const struct device *dev)
{
	i2c_write_short(dev, INA226_SLAVE_ADDRESS, INA226_CFG_REG, 0x8000);	// Reset
	i2c_write_short(dev, INA226_SLAVE_ADDRESS, INA226_CFG_REG, 0x4527);	// Average over 16 Samples
	i2c_write_short(dev, INA226_SLAVE_ADDRESS, INA226_CAL_REG, 1024);	// 1A, 0.100Ohm Resistor

	printf("Manufacturer ID:        0x%04X\r\n",i2c_read_short(dev, INA226_SLAVE_ADDRESS, INA226_MANUFACTURER_ID));
	printf("Die ID Register:        0x%04X\r\n",i2c_read_short(dev, INA226_SLAVE_ADDRESS, INA226_DIE_ID));
	printf("Configuration Register: 0x%04X\r\n",i2c_read_short(dev, INA226_SLAVE_ADDRESS, INA226_CFG_REG));
}

float ina226_voltage(const struct device *dev)
{
	unsigned int iBusVoltage;
	float fBusVoltage;

	iBusVoltage = i2c_read_short(dev, INA226_SLAVE_ADDRESS, INA226_BUS_VOLT_REG);
	fBusVoltage = (iBusVoltage) * 0.00125;
	//printf("Bus Voltage = %.2fV, ", fBusVoltage);

	return (fBusVoltage);
}

float ina226_current(const struct device *dev)
{
	unsigned int iCurrent;
	float fCurrent;

	iCurrent = i2c_read_short(dev, INA226_SLAVE_ADDRESS, INA226_CURRENT_REG);
	// Internally Calculated as Current = ((ShuntVoltage * CalibrationRegister) / 2048)
	fCurrent = iCurrent * 0.0005;
	//printf("Current = %.3fA\r\n", fCurrent);

	return (fCurrent);
}

float ina226_power(const struct device *dev)
{
	unsigned int iPower;
	float fPower;

	iPower = i2c_read_short(dev, INA226_SLAVE_ADDRESS, INA226_POWER_REG);
	// The Power Register LSB is internally programmed to equal 25 times the programmed value of the Current_LSB
	fPower = iPower * 0.0125;

	//printf("Power = %.2fW\r\n", fPower);
	return (fPower);
}
```

## src/ina226.h
```c
/*
 * INA226 - TI Current/Voltage/Power Monitor Code
 * Copyright (C) 2021 Craig Peacock
 *
 * This program is free software; you can redistribute it and/or
 * modify it under the terms of the GNU General Public License
 * as published by the Free Software Foundation; either version 3
 * of the License, or (at your option) any later version.
 *
 * This program is distributed in the hope that it will be useful,
 * but WITHOUT ANY WARRANTY; without even the implied warranty of
 * MERCHANTABILITY or FITNESS FOR A PARTICULAR PURPOSE.  See the
 * GNU General Public License for more details.
 *
 * You should have received a copy of the GNU General Public License
 * along with this program; if not, write to the Free Software
 * Foundation, Inc., 51 Franklin Street, Fifth Floor, Boston, MA
 * 02110-1301, USA.
 */

#ifndef MAIN_INA226_H_
#define MAIN_INA226_H_

#define INA226_SLAVE_ADDRESS	0x40
#define INA226_CFG_REG		0x00
#define INA226_SHUNT_VOLT_REG	0x01
#define INA226_BUS_VOLT_REG	0x02
#define INA226_POWER_REG	0x03
#define INA226_CURRENT_REG	0x04
#define INA226_CAL_REG		0x05
#define INA226_MASKEN_REG	0x06
#define INA226_ALERT_LMT_REG	0x07
#define INA226_MANUFACTURER_ID	0xFE
#define INA226_DIE_ID		0xFF

void ina226_init(const struct device *dev);
float ina226_voltage(const struct device *dev);
float ina226_current(const struct device *dev);
float ina226_power(const struct device *dev);

#endif
```

## src/shtc3.c
```c
#include <zephyr.h>
#include <device.h>
#include <stdint.h>
#include <device.h>
#include <sys/printk.h>
#include <device.h>
#include <drivers/i2c.h>
#include <sys/byteorder.h>
#include "shtc3.h"

uint8_t shtc3_GetTempAndHumidity(const struct device *dev, uint16_t * temperature, uint16_t * humidity)
{
    union DATA data;
    uint8_t error = 0; 

    uint16_t cmd = __bswap_16(SHTC3_READ_T_FIRST);
    int ret = i2c_write(dev, (uint8_t *)&cmd, 2, SHTC3_ADDR);

    do {    
        ret = i2c_read(dev, (uint8_t *)&data, 6, SHTC3_ADDR);
        error++;
    } while ((ret != 0) && (error < SHTC3_NO_RETRIES));
    if (ret != 0) {
        printk("SHTC3: Get Temp & Humd Error\n");
        return SHTC3_I2C_ERROR;
    }

    error = shtc3_checkcrc((uint8_t *)&data.meas.temperature, 2, data.meas.temperature_crc);
    if (error != SHTC3_NO_ERROR) {
        printk("Temperature Checksum Error\r\n");
    } else {
        *temperature = __bswap_16(data.meas.temperature);
    }
    
    error = shtc3_checkcrc((uint8_t *)&data.meas.humidity, 2, data.meas.humidity_crc);
    if (error != SHTC3_NO_ERROR) {
        printk("Humidity Checksum Error\r\n");
    } else {
        *humidity = __bswap_16(data.meas.humidity);
    }

    return SHTC3_NO_ERROR;
}

uint8_t shtc3_checkcrc(uint8_t data[], uint8_t nbrOfBytes, uint8_t checksum)
{
  uint8_t bitmask;      // Bit mask
  uint8_t crc = 0xFF;   // Calculated checksum
  uint8_t byteCtr;      // Byte counter
 
  // Calculates 8-Bit checksum with given polynomial
  for(byteCtr = 0; byteCtr < nbrOfBytes; byteCtr++) {
    crc ^= (data[byteCtr]);
    for(bitmask = 8; bitmask > 0; --bitmask) {
      if(crc & 0x80) {
        crc = (crc << 1) ^ CRC_POLYNOMIAL;
      } else {
        crc = (crc << 1);
      }
    }
  }

  // Verify checksum
  if(crc != checksum) {
    return SHTC3_CHECKSUM_ERROR;
  } else {
    return SHTC3_NO_ERROR;
  }
}

float shtc3_convert_humd(uint16_t raw_humd)
{
    float humidity = 100.0 * ((float)raw_humd / 65536);
    //printk("RH %.01f%%\r\n", humidity);
    return(humidity);
}

float shtc3_convert_temp(uint16_t raw_temp)
{
    float temperature = 175.0 * ((float)raw_temp / 65536.0) - 45.0;
    //printk("Temp %.02f degC\r\n", temperature);
    return (temperature);
}

uint8_t shtc3_wakeup(const struct device *dev)
{
    uint16_t cmd = __bswap_16(SHTC3_WAKEUP);
    int ret = i2c_write(dev, (uint8_t *)&cmd, 2, SHTC3_ADDR);
    if (ret != 0) {
        printk("SHTC3: Wakeup Error\n");
        return SHTC3_I2C_ERROR;
    }
    return SHTC3_NO_ERROR;
}

uint8_t shtc3_sleep(const struct device *dev)
{
    uint16_t cmd = __bswap_16(SHTC3_SLEEP);
    int ret = i2c_write(dev, (uint8_t *)&cmd, 2, SHTC3_ADDR);
    if (ret != 0) {
        printk("SHTC3: Sleep Error\n");
        return SHTC3_I2C_ERROR;
    }
    return SHTC3_NO_ERROR;
}

uint8_t shtc3_software_reset(const struct device *dev)
{
    uint16_t cmd = __bswap_16(SHTC3_SWRESET);
    int ret = i2c_write(dev, (uint8_t *)&cmd, 2, SHTC3_ADDR);
    if (ret != 0) {
        printk("SHTC3: Sleep Error\n");
        return SHTC3_I2C_ERROR;
    }
    return SHTC3_NO_ERROR;
}

uint8_t shtc3_readid(const struct device *dev)
{
    uint16_t cmd = __bswap_16(SHTC3_IDREG);
    uint8_t buffer[3];
    
    int ret = i2c_write_read(dev, SHTC3_ADDR, (uint8_t *)&cmd, 2, buffer, 3);
    if (ret != 0) {
        printk("SHTC3: Read ID Error\n");
        return SHTC3_I2C_ERROR;
    }
    
    printk("ID Reg = 0x%02X%02X, Checksum 0x%02X\r\n", buffer[0], buffer[1], buffer[2]);

    ret = shtc3_checkcrc((uint8_t *)&buffer[0], 2, buffer[2]);
    if (ret != SHTC3_NO_ERROR) {
        printk("Checksum Error\n");
        return SHTC3_CHECKSUM_ERROR;
    }

    return SHTC3_NO_ERROR;
}
```

## src/shtc3.h
```c
/*
 * SHTC3 - Sensirion Humidity and Temperature Sensor Code
 * Copyright (C) 2022 Craig Peacock
 *
 * This program is free software; you can redistribute it and/or
 * modify it under the terms of the GNU General Public License
 * as published by the Free Software Foundation; either version 3
 * of the License, or (at your option) any later version.
 *
 * This program is distributed in the hope that it will be useful,
 * but WITHOUT ANY WARRANTY; without even the implied warranty of
 * MERCHANTABILITY or FITNESS FOR A PARTICULAR PURPOSE.  See the
 * GNU General Public License for more details.
 *
 * You should have received a copy of the GNU General Public License
 * along with this program; if not, write to the Free Software
 * Foundation, Inc., 51 Franklin Street, Fifth Floor, Boston, MA
 * 02110-1301, USA.
 */

#define SHTC3_ADDR              0x70

#define SHTC3_SLEEP             0xB098
#define SHTC3_WAKEUP            0x3517
#define SHTC3_SWRESET           0x805D     
#define SHTC3_IDREG             0xEFC8
#define SHTC3_READ_T_FIRST      0x7866
#define SHTC3_READ_RH_FIRST     0x58E0

#define CRC_POLYNOMIAL          0x131 // P(x) = x^8 + x^5 + x^4 + 1 = 100110001
#define SHTC3_NO_ERROR          0
#define SHTC3_CHECKSUM_ERROR    -1
#define SHTC3_I2C_ERROR         -2

#define SHTC3_NO_RETRIES        100

struct VALUES {
    uint16_t    temperature;
    uint8_t     temperature_crc;
    uint16_t    humidity;
    uint8_t     humidity_crc;
} __attribute__((packed));

union DATA {
    struct VALUES meas;
    uint8_t buffer[6];
};

uint8_t shtc3_sleep(const struct device *dev);
uint8_t shtc3_wakeup(const struct device *dev);
uint8_t shtc3_readid(const struct device *dev);
uint8_t shtc3_software_reset(const struct device *dev);
uint8_t shtc3_GetTempAndHumidity(const struct device *dev, uint16_t * temperature, uint16_t * humidity);
uint8_t shtc3_checkcrc(uint8_t data[], uint8_t nbrOfBytes, uint8_t checksum);

float shtc3_convert_humd(uint16_t raw_humd);
float shtc3_convert_temp(uint16_t raw_temp);
```
