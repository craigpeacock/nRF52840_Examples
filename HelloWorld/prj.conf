## CMakeLists.txt
```
# SPDX-License-Identifier: Apache-2.0

cmake_minimum_required(VERSION 3.20.0)

find_package(Zephyr REQUIRED HINTS $ENV{ZEPHYR_BASE})
project(hello_world)

FILE(GLOB app_sources src/*.c)
target_sources(app PRIVATE ${app_sources})
```

## prj.conf
```kconfig
CONFIG_CONSOLE=y

# Use UART for Console
CONFIG_SERIAL=y
CONFIG_UART_CONSOLE=y

# Use Segger RTT Console
#CONFIG_RTT_CONSOLE=y
#CONFIG_USE_SEGGER_RTT=y

# USB CDC Console Options:
# If using USB-CDC ensure app.overlay is present
CONFIG_USB_DEVICE_STACK=y
CONFIG_USB_DEVICE_PRODUCT="Zephyr Console"
CONFIG_UART_LINE_CTRL=y
# Values below are for testing and MUST be configured for USB products
CONFIG_USB_DEVICE_VID=0x2FE3
CONFIG_USB_DEVICE_PID=0x100

# If target is nRF52840-Dongle, don't link for use with nRF5 Bootloader
CONFIG_BOARD_HAS_NRF5_BOOTLOADER=y
```

## src/main.c
```c
#include <stdio.h>
#include <string.h>
#include <zephyr/device.h>
#include <zephyr/kernel.h>

#include "usbcdc.h"

void main(void)
{
	usbconsole_init();	// Initialse USB-CDC Console

	while (1) {
		printk("Hello World\n");
		k_msleep(1000);
	}
}
```

## src/usbcdc.c
```c
/*
 * Copyright (c) 2023 Craig Peacock
 * Copyright (c) 2020 Nordic Semiconductor ASA
 *
 * SPDX-License-Identifier: LicenseRef-Nordic-5-Clause
 */

#include <zephyr/device.h>
#include <zephyr/kernel.h>
#include <zephyr/sys/printk.h>
#include <zephyr/usb/usb_device.h>
#include <zephyr/drivers/uart.h>

void usbconsole_init(void) {

#ifdef CONFIG_USB_DEVICE_STACK
	/* 
	 * If the app is built with USB device support, redirect console to
	 * USB CDC. This is useful on the nRF52840 Dongle
	 * https://www.nordicsemi.com/Products/Development-hardware/nrf52840-dongle
	 */

	const struct device *const dev = DEVICE_DT_GET(DT_CHOSEN(zephyr_console));
	uint32_t dtr = 0;

	if (usb_enable(NULL)) {
		return;
	}

	/* Poll if the DTR flag was set */
	while (!dtr) {
		uart_line_ctrl_get(dev, UART_LINE_CTRL_DTR, &dtr);
		/* Give CPU resources to low priority threads. */
		k_sleep(K_MSEC(100));
	}
    
#endif

}
```
