## prj.conf
```kconfig
CONFIG_SERIAL=y
CONFIG_CONSOLE=y
CONFIG_UART_CONSOLE=y

# Segger RTT Console Options:
CONFIG_USE_SEGGER_RTT=n
CONFIG_RTT_CONSOLE=n

# USB CDC Console Options:
# If using USB-CDC ensure app.overlay is present
#CONFIG_USB_DEVICE_STACK=y
#CONFIG_USB_DEVICE_PRODUCT="Console"
#CONFIG_UART_LINE_CTRL=y

CONFIG_DYNAMIC_INTERRUPTS=y

# Compile with or with-out bootloader found on the nRF52840
CONFIG_BOARD_HAS_NRF5_BOOTLOADER=n
```

## src/main.c
```c
/*
 * Copyright (c) 2023 Craig Peacock
 * Copyright (c) 2020 Nordic Semiconductor ASA
 *
 * SPDX-License-Identifier: LicenseRef-Nordic-5-Clause
 */

#include <zephyr/device.h>
#include <zephyr/kernel.h>
#include <zephyr/sys/printk.h>
#include <hal/nrf_radio.h>

#include "usbcdc.h"
#include "clocks.h"
#include "radio.h"

#define TRANSMIT_MESSAGES

void transmit_msg(void)
{
	uint8_t payload_size = 10;

	// First byte of packet contains length
	tx_packet[0] = payload_size;

	// Fill payload with sequential numbers
	for (int i = 1; i <= payload_size; i++) {
		tx_packet[i] = i;
	}
	
	// Tell radio to initiate transmit
	radio_tx();
}

void main(void)
{
	usbconsole_init();	// Initialse USB-CDC Console

	printk("IEEE802.15.4 Radio Example\nBoard: %s\n", CONFIG_BOARD);

	clock_init();		// Set-up HF clock

	radio_config(NRF_RADIO_MODE_IEEE802154_250KBIT, TRANSMIT_PATTERN_RANDOM);
	/* 
	 * Valid options for Mode:
	 *
	 * NRF_RADIO_MODE_NRF_1MBIT 			1Mbit/s Nordic proprietary radio mode.
	 * NRF_RADIO_MODE_NRF_2MBIT 			2Mbit/s Nordic proprietary radio mode.
	 * NRF_RADIO_MODE_NRF_250KBIT 			250Kbit/s Nordic proprietary radio mode.
	 * NRF_RADIO_MODE_BLE_1MBIT 			1 Mbit/s Bluetooth Low Energy.
	 * NRF_RADIO_MODE_BLE_2MBIT 			2 Mbit/s Bluetooth Low Energy.
	 * NRF_RADIO_MODE_BLE_LR125KBIT 		Bluetooth Low Energy Long range 125 kbit/s TX, 125 kbit/s and 500 kbit/s RX
	 * NRF_RADIO_MODE_BLE_LR500KBIT 		Bluetooth Low Energy Long range 500 kbit/s TX, 125 kbit/s and 500 kbit/s RX
	 * NRF_RADIO_MODE_IEEE802154_250KBIT 	IEEE 802.15.4-2006 250 kbit/s. 
	 * 
	 * */
	
	radio_set_channel(11);
	/*
	 * The IEEE 802.15.4 Standard defines 16 channels:
	 *
	 * Channel 11 - 2405 MHz
	 * Channel 12 - 2410 MHz
	 * Channel 13 - 2415 MHz
	 * Channel 14 - 2420 MHz
	 * Channel 15 - 2425 MHz
	 * Channel 16 - 2430 MHz
	 * Channel 17 - 2435 MHz
	 * Channel 18 - 2440 MHz 
	 * Channel 19 - 2445 MHz
	 * Channel 20 - 2450 MHz
	 * Channel 21 - 2455 MHz
	 * Channel 22 - 2460 MHz
	 * Channel 23 - 2465 MHz
	 * Channel 24 - 2470 MHz
	 * Channel 25 - 2475 MHz
	 * Channel 26 - 2480 MHz 
	 */

	radio_enable_interrupt();	// Enables interrupts and callback handler
	
	radio_rx();		// Start radio in receive mode

	while (1) {
#ifdef TRANSMIT_MESSAGES
		transmit_msg();
#endif
		k_msleep(5000);
	}
}
```

## src/clocks.c
```c
/*
 * Copyright (c) 2023 Craig Peacock
 * Copyright (c) 2020 Nordic Semiconductor ASA
 *
 * SPDX-License-Identifier: LicenseRef-Nordic-5-Clause
 */

#include <zephyr/device.h>
#include <zephyr/kernel.h>
#include <zephyr/drivers/clock_control.h>
#include <zephyr/drivers/clock_control/nrf_clock_control.h>

void clock_init(void)
{
	int err;
	int res;
	struct onoff_manager *clk_mgr;
	struct onoff_client clk_cli;

	clk_mgr = z_nrf_clock_control_get_onoff(CLOCK_CONTROL_NRF_SUBSYS_HF);
	if (!clk_mgr) {
		printk("Unable to get the Clock manager\n");
		return;
	}

	sys_notify_init_spinwait(&clk_cli.notify);

	err = onoff_request(clk_mgr, &clk_cli);
	if (err < 0) {
		printk("Clock request failed: %d\n", err);
		return;
	}

	do {
		err = sys_notify_fetch_result(&clk_cli.notify, &res);
		if (!err && res) {
			printk("Clock could not be started: %d\n", res);
			return;
		}
	} while (err);

	printk("HF Clock has started\n");
}
```

## src/clocks.h
```c
/*
 * Copyright (c) 2023 Craig Peacock
 * Copyright (c) 2020 Nordic Semiconductor ASA
 *
 * SPDX-License-Identifier: LicenseRef-Nordic-5-Clause
 */

void clock_init(void);
```

## src/radio.c
```c
/*
 * Copyright (c) 2023 Craig Peacock
 * Copyright (c) 2020 Nordic Semiconductor ASA
 *
 * SPDX-License-Identifier: LicenseRef-Nordic-5-Clause
 */

#include <zephyr/kernel.h>
#include <zephyr/types.h>
#include <hal/nrf_radio.h>
#include <string.h>

#include "radio.h"

/* Buffer for the radio TX packet */
uint8_t tx_packet[RADIO_MAX_PAYLOAD_LEN];

/* Buffer for the radio RX packet. */
uint8_t rx_packet[RADIO_MAX_PAYLOAD_LEN];

/* Number of transmitted packets. */
uint32_t tx_packet_cnt;

/* Number of received packets with valid CRC. */
uint32_t rx_packet_cnt;

/* Total payload size */
static uint16_t total_payload_size;

void radio_rx(void)
{
	radio_disable();

	nrf_radio_shorts_enable(NRF_RADIO,
				NRF_RADIO_SHORT_READY_START_MASK |
				NRF_RADIO_SHORT_END_START_MASK);
	nrf_radio_packetptr_set(NRF_RADIO, rx_packet);

	nrf_radio_int_enable(NRF_RADIO, NRF_RADIO_INT_CRCOK_MASK);
	nrf_radio_task_trigger(NRF_RADIO, NRF_RADIO_TASK_RXEN);
}

void radio_tx(void)
{
	radio_disable();
	
	nrf_radio_shorts_enable(NRF_RADIO,
				NRF_RADIO_SHORT_READY_START_MASK |
				NRF_RADIO_SHORT_END_DISABLE_MASK);
	nrf_radio_packetptr_set(NRF_RADIO, tx_packet);

	tx_packet_cnt++;

	nrf_radio_int_enable(NRF_RADIO, NRF_RADIO_INT_END_MASK);
	nrf_radio_task_trigger(NRF_RADIO, NRF_RADIO_TASK_TXEN);

	printk("TX %03d: ", tx_packet_cnt);
	int len = tx_packet[0];
	for (int i = 0; i <= len; i++) {
		printk("%02X ", tx_packet[i]);
	}
	printk("\n");
}

void radio_disable(void)
{
	nrf_radio_shorts_set(NRF_RADIO, 0);
	nrf_radio_int_disable(NRF_RADIO, ~0);
	nrf_radio_event_clear(NRF_RADIO, NRF_RADIO_EVENT_DISABLED);

	nrf_radio_task_trigger(NRF_RADIO, NRF_RADIO_TASK_DISABLE);
	while (!nrf_radio_event_check(NRF_RADIO, NRF_RADIO_EVENT_DISABLED)) {
		/* Do nothing */
	}
	nrf_radio_event_clear(NRF_RADIO, NRF_RADIO_EVENT_DISABLED);
}

void radio_config(nrf_radio_mode_t mode, enum transmit_pattern pattern)
{
	nrf_radio_packet_conf_t packet_conf;

	rx_packet_cnt = 0;
	tx_packet_cnt = 0;

	nrf_radio_mode_set(NRF_RADIO, mode);

	/* Set fast ramp-up time. */
	nrf_radio_modecnf0_set(NRF_RADIO, true, RADIO_MODECNF0_DTX_Center);

	/* Disable CRC. */
	nrf_radio_crc_configure(NRF_RADIO, RADIO_CRCCNF_LEN_Disabled,
				NRF_RADIO_CRC_ADDR_INCLUDE, 0);

	/* Set the device address 0 to use when transmitting. */
	nrf_radio_txaddress_set(NRF_RADIO, 0);

	/* Enable the device address 0 to use to select which addresses to receive */
	nrf_radio_rxaddresses_set(NRF_RADIO, 1);

	/* Set the address according to the transmission pattern. */
	switch (pattern) {

		case TRANSMIT_PATTERN_RANDOM:
			nrf_radio_prefix0_set(NRF_RADIO, 0xAB);
			nrf_radio_base0_set(NRF_RADIO, 0xABABABAB);
			break;

		case TRANSMIT_PATTERN_11001100:
			nrf_radio_prefix0_set(NRF_RADIO, 0xCC);
			nrf_radio_base0_set(NRF_RADIO, 0xCCCCCCCC);
			break;

		case TRANSMIT_PATTERN_11110000:
			nrf_radio_prefix0_set(NRF_RADIO, 0x6A);
			nrf_radio_base0_set(NRF_RADIO, 0x58FE811B);
			break;

		default:
			return;
	}

	/* Packet configuration:
	 * payload length size = 8 bits,
	 * 0-byte static length, max 255-byte payload,
	 * 4-byte base address length (5-byte full address length),
	 * Bit 24: 1 Big endian,
	 * Bit 25: 1 Whitening enabled.
	 */
	memset(&packet_conf, 0, sizeof(packet_conf));
	packet_conf.lflen = RADIO_LENGTH_LENGTH_FIELD;
	packet_conf.maxlen = (sizeof(tx_packet) - 1);
	packet_conf.statlen = 0;
	packet_conf.balen = 4;
	packet_conf.big_endian = true;
	packet_conf.whiteen = true;

	switch (mode) {
#if CONFIG_HAS_HW_NRF_RADIO_IEEE802154
	case NRF_RADIO_MODE_IEEE802154_250KBIT:
		/* Packet configuration:
		 * S1 size = 0 bits,
		 * S0 size = 0 bytes,
		 * 32-bit preamble.
		 */
		packet_conf.plen = NRF_RADIO_PREAMBLE_LENGTH_32BIT_ZERO;
		packet_conf.maxlen = IEEE_MAX_PAYLOAD_LEN;
		packet_conf.balen = 0;
		packet_conf.big_endian = false;
		packet_conf.whiteen = false;

		/* Preamble, address (BALEN + PREFIX), lflen and payload */
		total_payload_size = 4 + (packet_conf.balen + 1) + 1 + packet_conf.maxlen;
		break;
#endif /* CONFIG_HAS_HW_NRF_RADIO_IEEE802154 */

#if CONFIG_HAS_HW_NRF_RADIO_BLE_CODED
	case NRF_RADIO_MODE_BLE_LR500KBIT:
	case NRF_RADIO_MODE_BLE_LR125KBIT:
		/* Packet configuration:
		 * S1 size = 0 bits,
		 * S0 size = 0 bytes,
		 * 10 bytes preamble.
		 */
		packet_conf.plen = NRF_RADIO_PREAMBLE_LENGTH_LONG_RANGE;
		packet_conf.cilen = 2;
		packet_conf.termlen = 3;
		packet_conf.big_endian = false;
		packet_conf.balen = 3;

		/* Set CRC length; CRC calculation does not include the address
		 * field.
		 */
		nrf_radio_crc_configure(NRF_RADIO, RADIO_CRCCNF_LEN_Three,
					NRF_RADIO_CRC_ADDR_SKIP, 0);

		/* Preamble, address (BALEN + PREFIX), lflen, code indicator, TERM, payload, CRC */
		total_payload_size = 10 + (packet_conf.balen + 1) + 1 + packet_conf.cilen +
				  packet_conf.termlen + packet_conf.maxlen + RADIO_CRCCNF_LEN_Three;
		break;

#endif /* CONFIG_HAS_HW_NRF_RADIO_BLE_CODED */

	case NRF_RADIO_MODE_BLE_2MBIT:
		/* Packet configuration:
		 * S1 size = 0 bits,
		 * S0 size = 0 bytes,
		 * 16-bit preamble.
		 */
		packet_conf.plen = NRF_RADIO_PREAMBLE_LENGTH_16BIT;

		/* preamble, address (BALEN + PREFIX), lflen and payload */
		total_payload_size = 2 + (packet_conf.balen + 1) + 1 + packet_conf.maxlen;
		break;

	default:
		/* Packet configuration:
		 * S1 size = 0 bits,
		 * S0 size = 0 bytes,
		 * 8-bit preamble.
		 */
		packet_conf.plen = NRF_RADIO_PREAMBLE_LENGTH_8BIT;

		/* preamble, address (BALEN + PREFIX), lflen, and payload */
		total_payload_size = 1 + (packet_conf.balen + 1) + 1 + packet_conf.maxlen;
		break;
	}

	nrf_radio_packet_configure(NRF_RADIO, &packet_conf);
}

void radio_set_channel(uint8_t channel)
{
	uint16_t frequency = 2400 + IEEE_FREQ_CALC(channel);
	printk("Channel %d, Frequency = %dMHz\n", channel, frequency);
	nrf_radio_frequency_set(NRF_RADIO, frequency);
}

void radio_set_frequency(uint16_t frequency)
{
	printk("Frequency = %dMHz\n", frequency);
	nrf_radio_frequency_set(NRF_RADIO, frequency);
}

void radio_enable_interrupt(void)
{
	irq_connect_dynamic(RADIO_IRQn, IRQ_PRIO_LOWEST, radio_handler, NULL, 0);
	irq_enable(RADIO_IRQn);
}

void radio_handler(const void *context)
{
	if (nrf_radio_event_check(NRF_RADIO, NRF_RADIO_EVENT_CRCOK)) {
		nrf_radio_event_clear(NRF_RADIO, NRF_RADIO_EVENT_CRCOK);
		rx_packet_cnt++;

		printk("RX %03d: ",rx_packet_cnt);
		int len = rx_packet[0];
		for (int i = 0; i <= len; i++) {
			printk("%02X ", rx_packet[i]);
		}
		printk("\n");
	}

	if (nrf_radio_event_check(NRF_RADIO, NRF_RADIO_EVENT_CRCERROR)) {
		nrf_radio_event_clear(NRF_RADIO, NRF_RADIO_EVENT_CRCERROR);
		printk("RX CRC Error\n");
	}

	if (nrf_radio_event_check(NRF_RADIO, NRF_RADIO_EVENT_END)) {
		nrf_radio_event_clear(NRF_RADIO, NRF_RADIO_EVENT_END);
		//printk("Radio Event End\n");
		// Return radio back to receive.
		radio_rx();
	}
}

void radio_power_set(int8_t power)
{
	nrf_radio_txpower_set(NRF_RADIO, (nrf_radio_txpower_t)power);
	printk("Tx power set to: %" PRIi8 " dBm\n", power);
}
```

## src/radio.h
```c
/*
 * Copyright (c) 2023 Craig Peacock
 * Copyright (c) 2020 Nordic Semiconductor ASA
 *
 * SPDX-License-Identifier: LicenseRef-Nordic-5-Clause
 */

/**@brief Radio transmit and address pattern. */
enum transmit_pattern {
	/** Random pattern. */
	TRANSMIT_PATTERN_RANDOM,

	/** Pattern 11110000(F0). */
	TRANSMIT_PATTERN_11110000,

	/** Pattern 11001100(CC). */
	TRANSMIT_PATTERN_11001100,
};

void radio_rx(void);
void radio_tx(void);
void radio_disable(void);
void radio_config(nrf_radio_mode_t mode, enum transmit_pattern pattern);
void radio_set_channel(uint8_t channel);
void radio_set_frequency(uint16_t frequency);
void radio_enable_interrupt(void);
void radio_handler(const void *context);
void radio_power_set(int8_t power);

/** Maximum radio RX or TX payload. */
#define RADIO_MAX_PAYLOAD_LEN	256

/** IEEE 802.15.4 maximum payload length. */
#define IEEE_MAX_PAYLOAD_LEN	127

/** IEEE 802.15.4 minimum channel. */
#define IEEE_MIN_CHANNEL	11

/** IEEE 802.15.4 maximum channel. */
#define IEEE_MAX_CHANNEL	26

/* Length on air of the LENGTH field. */
#define RADIO_LENGTH_LENGTH_FIELD (8UL)

/* IEEE 802.15.4 default frequency. */
#define IEEE_DEFAULT_FREQ         (5)

/* 
 * Frequency calculation for a given channel in the IEEE 802.15.4 radio
 * mode.
 */
#define IEEE_FREQ_CALC(_channel) (IEEE_DEFAULT_FREQ + \
				 (IEEE_DEFAULT_FREQ * \
				 ((_channel) - IEEE_MIN_CHANNEL)))

/* Frequency calculation for a given channel. */
#define CHAN_TO_FREQ(_channel) (2400 + _channel)

/* Buffer for the radio TX packet */
extern uint8_t tx_packet[];

/* Buffer for the radio RX packet. */
extern uint8_t rx_packet[];
```

## src/usbcdc.h
```c
/*
 * Copyright (c) 2023 Craig Peacock
 * Copyright (c) 2020 Nordic Semiconductor ASA
 *
 * SPDX-License-Identifier: LicenseRef-Nordic-5-Clause
 */

void usbconsole_init(void);
```
