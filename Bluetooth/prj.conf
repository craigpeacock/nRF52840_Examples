## CMakeLists.txt
```
# SPDX-License-Identifier: Apache-2.0

cmake_minimum_required(VERSION 3.20.0)

find_package(Zephyr REQUIRED HINTS $ENV{ZEPHYR_BASE})
project(bluetooth)

FILE(GLOB app_sources src/*.c)
target_sources(app PRIVATE ${app_sources})
```

## prj.conf
```kconfig
CONFIG_CONSOLE=y

CONFIG_I2C=y
CONFIG_NEWLIB_LIBC_FLOAT_PRINTF=y
CONFIG_CBPRINTF_FP_SUPPORT=y


# Use Segger RTT Console
CONFIG_USE_SEGGER_RTT=y
CONFIG_RTT_CONSOLE=y

# If target is nRF52840-Dongle, don't link for use with nRF5 Bootloader
CONFIG_BOARD_HAS_NRF5_BOOTLOADER=n

#Bluetooth
CONFIG_BT=y
CONFIG_BT_DEVICE_NAME="Beyondlogic Peripheral"
CONFIG_BT_DEVICE_APPEARANCE=0
#CONFIG_BT_DEVICE_NAME_DYNAMIC=y
#CONFIG_BT_DEVICE_NAME_MAX=65
CONFIG_BT_DEBUG_LOG=y
CONFIG_BT_SMP=y
CONFIG_BT_SIGNING=y
# Peripheral Role
CONFIG_BT_PERIPHERAL=y
CONFIG_BT_ATT_PREPARE_COUNT=5
CONFIG_BT_PRIVACY=y

# Enable Device Information Service (DIS)
CONFIG_BT_DIS=y
CONFIG_BT_DIS_MODEL="Example Widget"
CONFIG_BT_DIS_MANUF="Beyondlogic"
CONFIG_BT_DIS_PNP=n
#CONFIG_BT_DIS_PNP_VID=0
#CONFIG_BT_DIS_PNP_PID=0
CONFIG_BT_DIS_SERIAL_NUMBER=y
CONFIG_BT_DIS_SERIAL_NUMBER_STR="123ABCDEF"
CONFIG_BT_DIS_FW_REV=y
CONFIG_BT_DIS_FW_REV_STR="v1.1"
#CONFIG_BT_DIS_HW_REV
```

## src/main.c
```c
#include <stdio.h>
#include <string.h>
#include <device.h>
#include <zephyr.h>
#include <sys/byteorder.h>

#include <bluetooth/bluetooth.h>
#include <bluetooth/uuid.h>
#include <bluetooth/gatt.h>

#include <settings/settings.h>

#include <drivers/i2c.h>
#include "shtc3.h"


#define BT_UUID_BINARY_SENSOR			BT_UUID_DECLARE_16(0x183B)

#define BT_UUID_VOLTAGE 				BT_UUID_DECLARE_16(0x2B18)
#define BT_UUID_VOLTAGE_SPECIFICATION 	BT_UUID_DECLARE_16(0x2B19)

#define BT_UUID_ELECTIC_CURRENT			BT_UUID_DECLARE_16(0x2AEE)
#define BT_UUID_ELECTIC_CURRENT_RANGE
#define BT_UUID_ELECTIC_CURRENT_SPECIFICATION

#define BT_UUID_POWER					BT_UUID_DECLARE_16(0x2B05)
#define BT_UUID_POWER_SPECIFICATION		BT_UUID_DECLARE_16(0x2B06)


static const struct bt_data ad[] = {
	BT_DATA_BYTES(BT_DATA_FLAGS, (BT_LE_AD_GENERAL | BT_LE_AD_NO_BREDR)),
};

#define SENSOR_NAME_TEMPERATURE	"SHTC3 Temperature Sensor"
#define SENSOR_NAME_HUMIDITY	"SHTC3 Humidity Sensor"
#define SENSOR_NAME_VOLTAGE		"INA226 Voltage Sensor"
#define SENSOR_NAME_CURRENT		"INA226 Current Sensor"

int16_t temperature;
int16_t humidity;

int16_t voltage;
int16_t current;

static ssize_t read_u16(struct bt_conn *conn, const struct bt_gatt_attr *attr,
			void *buf, uint16_t len, uint16_t offset)
{
	const uint16_t *u16 = attr->user_data;
	uint16_t value = sys_cpu_to_le16(*u16);

	return bt_gatt_attr_read(conn, attr, buf, len, offset, &value, sizeof(value));
}

BT_GATT_SERVICE_DEFINE(ess_svc,
	BT_GATT_PRIMARY_SERVICE(BT_UUID_ESS),

	/* Temperature Sensor */
	BT_GATT_CHARACTERISTIC(BT_UUID_TEMPERATURE,
			       BT_GATT_CHRC_READ, 
			       BT_GATT_PERM_READ,
			       read_u16, NULL, &temperature),
	BT_GATT_CUD(SENSOR_NAME_TEMPERATURE, BT_GATT_PERM_READ),

	/* Humidity Sensor */
	BT_GATT_CHARACTERISTIC(BT_UUID_HUMIDITY, 
				   BT_GATT_CHRC_READ,
			       BT_GATT_PERM_READ,
			       read_u16, NULL, &humidity),
	BT_GATT_CUD(SENSOR_NAME_HUMIDITY, BT_GATT_PERM_READ),

	/* Voltage Sensor */
	BT_GATT_CHARACTERISTIC(BT_UUID_VOLTAGE,
					BT_GATT_CHRC_READ,
					BT_GATT_PERM_READ,
					read_u16, NULL, &voltage),
	BT_GATT_CUD(SENSOR_NAME_VOLTAGE, BT_GATT_PERM_READ),
	
	/* Current Sensor */
	BT_GATT_CHARACTERISTIC(BT_UUID_ELECTIC_CURRENT,
					BT_GATT_CHRC_READ,
					BT_GATT_PERM_READ,
					read_u16, NULL, &current),
	BT_GATT_CUD(SENSOR_NAME_CURRENT, BT_GATT_PERM_READ),

);

void main(void)
{
	int err;
	uint16_t raw_temp;
	uint16_t raw_humd;

	// Voltage has a resolution of 1/64V	
	voltage = 3.3 * 64;
	// Current has a resolution of 0.01. 100 = 1.00A
	current = 100;

	const struct device *dev;

	printk("Beyondlogic Bluetooth LE Peripheral Example\n");

  	printk("Opening I2C\n");
  	dev = device_get_binding("I2C_0");
  	if (!dev) {
		printk("I2C: Device driver not found.\n");
		return;
  	} else {
        i2c_configure(dev, I2C_SPEED_SET(I2C_SPEED_STANDARD));
  	}

	err = bt_enable(NULL);
	if (err) {
		printk("Bluetooth init failed (err %d)\n", err);
		return;
	}

	printk("Bluetooth initialized\n");

	if (IS_ENABLED(CONFIG_SETTINGS)) {
		settings_load();
	}

	err = bt_le_adv_start(BT_LE_ADV_CONN_NAME, ad, ARRAY_SIZE(ad), NULL, 0);
	if (err) {
		printk("Advertising failed to start (err %d)\n", err);
		return;
	}

	printk("Advertising successfully started\n");

	shtc3_readid(dev);

	while (1) {
		k_msleep(1000);
		
		shtc3_wakeup(dev);
		k_msleep(2);
		shtc3_GetTempAndHumidity(dev, &raw_temp, &raw_humd);
		shtc3_sleep(dev);
		
		temperature = shtc3_convert_temp_int16(raw_temp);
		humidity = shtc3_convert_humd_int16(raw_humd);
		printk("Temp %d.%02d, Humd %d.%02d \r\n", temperature/100, temperature%100, humidity/100, humidity%100); 

		bt_gatt_notify(NULL, &ess_svc.attrs[2], &temperature, sizeof(temperature));
		bt_gatt_notify(NULL, &ess_svc.attrs[4], &humidity, sizeof(humidity));
		bt_gatt_notify(NULL, &ess_svc.attrs[6], &voltage, sizeof(voltage));
		bt_gatt_notify(NULL, &ess_svc.attrs[8], &current, sizeof(current));
	}
}
```

## src/shtc3.c
```c
#include <zephyr.h>
#include <device.h>
#include <stdint.h>
#include <device.h>
#include <sys/printk.h>
#include <device.h>
#include <drivers/i2c.h>
#include <sys/byteorder.h>
#include "shtc3.h"

uint8_t shtc3_GetTempAndHumidity(const struct device *dev, uint16_t * temperature, uint16_t * humidity)
{
    union DATA data;
    uint8_t error = 0; 

    uint16_t cmd = __bswap_16(SHTC3_READ_T_FIRST);
    int ret = i2c_write(dev, (uint8_t *)&cmd, 2, SHTC3_ADDR);

    do {    
        k_msleep(1);
        ret = i2c_read(dev, (uint8_t *)&data, 6, SHTC3_ADDR);
        error++;
    } while ((ret != 0) && (error < SHTC3_NO_RETRIES));
    if (ret != 0) {
        printk("SHTC3: Get Temp & Humd Error\n");
        return SHTC3_I2C_ERROR;
    }

    error = shtc3_checkcrc((uint8_t *)&data.meas.temperature, 2, data.meas.temperature_crc);
    if (error != SHTC3_NO_ERROR) {
        printk("Temperature Checksum Error\r\n");
    } else {
        *temperature = __bswap_16(data.meas.temperature);
    }
    
    error = shtc3_checkcrc((uint8_t *)&data.meas.humidity, 2, data.meas.humidity_crc);
    if (error != SHTC3_NO_ERROR) {
        printk("Humidity Checksum Error\r\n");
    } else {
        *humidity = __bswap_16(data.meas.humidity);
    }

    return SHTC3_NO_ERROR;
}

uint8_t shtc3_checkcrc(uint8_t data[], uint8_t nbrOfBytes, uint8_t checksum)
{
  uint8_t bitmask;      // Bit mask
  uint8_t crc = 0xFF;   // Calculated checksum
  uint8_t byteCtr;      // Byte counter
 
  // Calculates 8-Bit checksum with given polynomial
  for(byteCtr = 0; byteCtr < nbrOfBytes; byteCtr++) {
    crc ^= (data[byteCtr]);
    for(bitmask = 8; bitmask > 0; --bitmask) {
      if(crc & 0x80) {
        crc = (crc << 1) ^ CRC_POLYNOMIAL;
      } else {
        crc = (crc << 1);
      }
    }
  }

  // Verify checksum
  if(crc != checksum) {
    return SHTC3_CHECKSUM_ERROR;
  } else {
    return SHTC3_NO_ERROR;
  }
}

float shtc3_convert_humd(uint16_t raw_humd)
{
    float humidity = 100.0 * ((float)raw_humd / 65536);
    //printk("RH %.01f%%\r\n", humidity);
    return(humidity);
}

int16_t shtc3_convert_humd_int16(uint16_t raw_humd)
{
    float humidity = 100.0 * ((float)raw_humd / 65536);
    //printk("RH %.01f%%\r\n", humidity);
    return((int16_t)(humidity * 100));
}

float shtc3_convert_temp(uint16_t raw_temp)
{
    float temperature = 175.0 * ((float)raw_temp / 65536.0) - 45.0;
    //printk("Temp %.02f degC\r\n", temperature);
    return (temperature);
}

int16_t shtc3_convert_temp_int16(uint16_t raw_temp)
{
    float temperature = 175.0 * ((float)raw_temp / 65536.0) - 45.0;
    //printk("Temp %.02f degC\r\n", temperature);
    return ((int16_t)(temperature * 100));
}

uint8_t shtc3_wakeup(const struct device *dev)
{
    uint16_t cmd = __bswap_16(SHTC3_WAKEUP);
    int ret = i2c_write(dev, (uint8_t *)&cmd, 2, SHTC3_ADDR);
    if (ret != 0) {
        printk("SHTC3: Wakeup Error\n");
        return SHTC3_I2C_ERROR;
    }
    return SHTC3_NO_ERROR;
}

uint8_t shtc3_sleep(const struct device *dev)
{
    uint16_t cmd = __bswap_16(SHTC3_SLEEP);
    int ret = i2c_write(dev, (uint8_t *)&cmd, 2, SHTC3_ADDR);
    if (ret != 0) {
        printk("SHTC3: Sleep Error\n");
        return SHTC3_I2C_ERROR;
    }
    return SHTC3_NO_ERROR;
}

uint8_t shtc3_software_reset(const struct device *dev)
{
    uint16_t cmd = __bswap_16(SHTC3_SWRESET);
    int ret = i2c_write(dev, (uint8_t *)&cmd, 2, SHTC3_ADDR);
    if (ret != 0) {
        printk("SHTC3: Sleep Error\n");
        return SHTC3_I2C_ERROR;
    }
    return SHTC3_NO_ERROR;
}

uint8_t shtc3_readid(const struct device *dev)
{
    uint16_t cmd = __bswap_16(SHTC3_IDREG);
    uint8_t buffer[3];
    
    int ret = i2c_write_read(dev, SHTC3_ADDR, (uint8_t *)&cmd, 2, buffer, 3);
    if (ret != 0) {
        printk("SHTC3: Read ID Error\n");
        return SHTC3_I2C_ERROR;
    }
    
    printk("ID Reg = 0x%02X%02X, Checksum 0x%02X\r\n", buffer[0], buffer[1], buffer[2]);

    ret = shtc3_checkcrc((uint8_t *)&buffer[0], 2, buffer[2]);
    if (ret != SHTC3_NO_ERROR) {
        printk("Checksum Error\n");
        return SHTC3_CHECKSUM_ERROR;
    }

    return SHTC3_NO_ERROR;
}
```

## src/shtc3.h
```c
/*
 * SHTC3 - Sensirion Humidity and Temperature Sensor Code
 * Copyright (C) 2022 Craig Peacock
 *
 * This program is free software; you can redistribute it and/or
 * modify it under the terms of the GNU General Public License
 * as published by the Free Software Foundation; either version 3
 * of the License, or (at your option) any later version.
 *
 * This program is distributed in the hope that it will be useful,
 * but WITHOUT ANY WARRANTY; without even the implied warranty of
 * MERCHANTABILITY or FITNESS FOR A PARTICULAR PURPOSE.  See the
 * GNU General Public License for more details.
 *
 * You should have received a copy of the GNU General Public License
 * along with this program; if not, write to the Free Software
 * Foundation, Inc., 51 Franklin Street, Fifth Floor, Boston, MA
 * 02110-1301, USA.
 */

#define SHTC3_ADDR              0x70

#define SHTC3_SLEEP             0xB098
#define SHTC3_WAKEUP            0x3517
#define SHTC3_SWRESET           0x805D     
#define SHTC3_IDREG             0xEFC8
#define SHTC3_READ_T_FIRST      0x7866
#define SHTC3_READ_RH_FIRST     0x58E0

#define CRC_POLYNOMIAL          0x131 // P(x) = x^8 + x^5 + x^4 + 1 = 100110001
#define SHTC3_NO_ERROR          0
#define SHTC3_CHECKSUM_ERROR    -1
#define SHTC3_I2C_ERROR         -2

#define SHTC3_NO_RETRIES        100

struct VALUES {
    uint16_t    temperature;
    uint8_t     temperature_crc;
    uint16_t    humidity;
    uint8_t     humidity_crc;
} __attribute__((packed));

union DATA {
    struct VALUES meas;
    uint8_t buffer[6];
};

uint8_t shtc3_sleep(const struct device *dev);
uint8_t shtc3_wakeup(const struct device *dev);
uint8_t shtc3_readid(const struct device *dev);
uint8_t shtc3_software_reset(const struct device *dev);
uint8_t shtc3_GetTempAndHumidity(const struct device *dev, uint16_t * temperature, uint16_t * humidity);
uint8_t shtc3_checkcrc(uint8_t data[], uint8_t nbrOfBytes, uint8_t checksum);

float shtc3_convert_humd(uint16_t raw_humd);
float shtc3_convert_temp(uint16_t raw_temp);
int16_t shtc3_convert_temp_int16(uint16_t raw_temp);
int16_t shtc3_convert_humd_int16(uint16_t raw_humd);
```
